## board/jetlab/common/package/Config.in
```kconfig
menu "Jetlab packages"

source board/jetlab/common/package/jetv4l2/Config.in

source board/jetlab/common/package/tiobench/Config.in

endmenu
```

## configs/amlogic_c305x_arm32_defconfig
```kconfig
#include "arm32_a35.config"
#include "arm32_glibc.config"
#include "base.config"
BR2_PACKAGE_C305X=y
```

## configs/amlogic_c305x_arm64_defconfig
```kconfig
#include "c305x_arm64.config"
#include "arm64_musl.config"
#include "base.config"
#include "debug.config"
#include "gdb.config"
#include "gst.config"
#include "gst_rtsp.config"
BR2_PACKAGE_FFMPEG=y
BR2_PACKAGE_FFMPEG_ENCODERS="mp2 adpcm_g726 pcm_alaw pcm_mulaw rawvideo mjpeg mpeg2video"
BR2_PACKAGE_FFMPEG_DECODERS="pcm_alaw pcm_mulaw rawvideo mjpeg mpeg2video"
BR2_PACKAGE_FFMPEG_MUXERS="pcm_alaw pcm_mulaw g722 g726 adts rawvideo mjpeg mp4 mov rtp flv f4v mpegts matroska avi rtsp mpeg1system"
BR2_PACKAGE_FFMPEG_DEMUXERS="pcm_alaw pcm_mulaw g722 g726 rawvideo mpegts mov flv matroska avi"
BR2_PACKAGE_FFMPEG_PARSERS=""
BR2_PACKAGE_FFMPEG_BSFS="aac_adtstoasc h264_metadata h264_mp4toannexb h264_redundant_pps hevc_metadata hevc_mp4toannexb dump_extradata remove_extradata"
BR2_PACKAGE_FFMPEG_PROTOCOLS="file rtp srtp rtmp rtmps http https"
BR2_PACKAGE_FFMPEG_FILTERS="scale"
BR2_PACKAGE_LIVE555=y
```

## configs/arm64_ubuntu_defconfig
```kconfig
#include "arm64_a35.config"
#include "arm64_glibc.config"
#include "base.config"
#include "ubuntu.config"

BR2_ROOTFS_POST_BUILD_SCRIPT="system/ubuntu/ubuntu-post-build.sh"
BR2_ROOTFS_OVERLAY="system/ubuntu/target"
```

## configs/incstage_debug_defconfig
```kconfig
# Architecture
BR2_arm=y
BR2_cortex_a8=y

# Toolchain
BR2_TOOLCHAIN_BUILDROOT_LARGEFILE=y
BR2_TOOLCHAIN_BUILDROOT_INET_IPV6=y
BR2_TOOLCHAIN_BUILDROOT_INET_RPC=y
BR2_TOOLCHAIN_BUILDROOT_WCHAR=y

BR2_PACKAGE_HOST_GDB=y
BR2_TOOLCHAIN_BUILDROOT_CXX=y

# System
BR2_TARGET_GENERIC_HOSTNAME="Jetlab"
BR2_TARGET_GENERIC_ISSUE="Welcome to Jetlab"
BR2_ROOTFS_DEVICE_CREATION_DYNAMIC_DEVTMPFS=y
BR2_TARGET_GENERIC_GETTY_PORT="ttymxc0"

BR2_ROOTFS_POST_BUILD_SCRIPT="board/jetlab/incstage/post_build.sh"

# uboot
BR2_TARGET_UBOOT=y
BR2_TARGET_UBOOT_BOARDNAME="incstage"

BR2_TARGET_UBOOT_CUSTOM_GIT=y
BR2_TARGET_UBOOT_CUSTOM_GIT_REPO_URL="https://github.com/linux-knight/uboot.git"
BR2_TARGET_UBOOT_CUSTOM_GIT_VERSION="jetlab/incstage"

BR2_TARGET_UBOOT_FORMAT_CUSTOM=y
BR2_TARGET_UBOOT_FORMAT_CUSTOM_NAME="u-boot.imx"

# Benchmark package
BR2_PACKAGE_TIOBENCH=y
```

## configs/incstage_defconfig
```kconfig
# Architecture
BR2_arm=y
BR2_cortex_a8=y

# Toolchain
BR2_TOOLCHAIN_BUILDROOT_LARGEFILE=y
BR2_TOOLCHAIN_BUILDROOT_INET_IPV6=y
BR2_TOOLCHAIN_BUILDROOT_INET_RPC=y
BR2_TOOLCHAIN_BUILDROOT_WCHAR=y

BR2_PACKAGE_HOST_GDB=y
BR2_TOOLCHAIN_BUILDROOT_CXX=y

# System
BR2_TARGET_GENERIC_HOSTNAME="Jetlab"
BR2_TARGET_GENERIC_ISSUE="Welcome to Jetlab"
BR2_ROOTFS_DEVICE_CREATION_DYNAMIC_DEVTMPFS=y
BR2_TARGET_GENERIC_GETTY_PORT="ttymxc0"

BR2_ROOTFS_POST_BUILD_SCRIPT="board/jetlab/incstage/post_build.sh"
```

## configs/rtavs_arm32_musl_defconfig
```kconfig
BR2_arm=y
BR2_cortex_a7=y
BR2_ARM_FPU_NEON_VFPV4=y
BR2_HOST_DIR="/opt/armv7-eabihf-musl-2018.02"
BR2_TOOLCHAIN_BUILDROOT_VENDOR="rtavs"
BR2_TOOLCHAIN_BUILDROOT_MUSL=y
BR2_KERNEL_HEADERS_4_4=y
BR2_GCC_VERSION_7_X=y
BR2_TOOLCHAIN_BUILDROOT_CXX=y
BR2_PACKAGE_HOST_GDB=y
BR2_GDB_VERSION_8_0=y
BR2_INIT_NONE=y
BR2_SYSTEM_BIN_SH_NONE=y
# BR2_PACKAGE_BUSYBOX is not set
BR2_PACKAGE_GDB=y
# BR2_TARGET_ROOTFS_TAR is not set
```

## configs/rtavs_c305x_arm32_defconfig
```kconfig
#include "c305x_arm32.config"
#include "toolchain_glibc_arm32.config"
#include "system.config"
BR2_ROOTFS_RESIZE=y
```

## configs/rtavs_c305x_arm64_initramfs_finit_defconfig
```kconfig
#include "c305x_arm64.config"
#include "toolchain_musl_arm64.config"
#include "filesystem.config"
#include "debug.config"
BR2_INIT_FINIT=y
```

## configs/rtavs_c305x_arm64_ubuntu_defconfig
```kconfig
#include "c305x_arm64.config"
#include "toolchain_glibc_arm64.config"
#include "system.config"
#include "ubuntu.config"

BR2_ROOTFS_POST_BUILD_SCRIPT="system/ubuntu/ubuntu-post-build.sh"
BR2_ROOTFS_OVERLAY="system/ubuntu/target"
```

## external/Config.in
```kconfig
menu "External packages"

#source "$BR2_EXTERNAL/package/foo/Config.in"

#source "$BR2_EXTERNAL/package/hdmi/Config.in"

#if BR2_PACKAGE_BUSYBOX_SHOW_OTHERS
#source "$BR2_EXTERNAL/package/toybox/Config.in"
#endif

endmenu
```

## external/configs/miniboot_defconfig
```kconfig
# Architecture

BR2_arm=y
BR2_cortex_a9=y
BR2_ARM_EABIHF=y
BR2_ARM_ENABLE_NEON=y
BR2_ARM_FPU_NEON=y
BR2_ARM_INSTRUCTIONS_THUMB2=y

#
# Toolchain
#
BR2_TOOLCHAIN_EXTERNAL=y
BR2_TOOLCHAIN_EXTERNAL_LINARO_2014_02=y

#
# System configuration
#
BR2_TARGET_GENERIC_HOSTNAME="miniboot"
BR2_TARGET_GENERIC_ISSUE="Welcome to miniboot"
BR2_ROOTFS_DEVICE_CREATION_DYNAMIC_MDEV=y
BR2_TARGET_GENERIC_GETTY=y
BR2_TARGET_GENERIC_GETTY_PORT="ttyS0"


BR2_PACKAGE_YAVTA=y
BR2_PACKAGE_LIVE555=y
BR2_PACKAGE_MEDIASTREAMER=y

#
# Filesystem images

BR2_TARGET_ROOTFS_CPIO=y
BR2_TARGET_ROOTFS_CPIO_GZIP=y
BR2_TARGET_ROOTFS_EXT2=y
```

## external/configs/timebox_wip_defconfig
```kconfig
BR2_arm=y
BR2_cortex_a9=y
BR2_ARM_ENABLE_NEON=y
BR2_ARM_FPU_NEON=y
BR2_DEPRECATED=y
BR2_TOOLCHAIN_EXTERNAL=y
BR2_PACKAGE_OVERRIDE_FILE="$(BR2_EXTERNAL)/local.mk"

# Toolchains
BR2_ARM_EABIHF=y
BR2_TOOLCHAIN_EXTERNAL_LINARO_2014_02=y

# Welcome
BR2_TARGET_GENERIC_HOSTNAME="timebox"
BR2_TARGET_GENERIC_ISSUE="Welcome to timebox"
BR2_ROOTFS_DEVICE_CREATION_DYNAMIC_MDEV=y

# Linux Kernel
#BR2_LINUX_KERNEL=y
#BR2_LINUX_KERNEL_CUSTOM_GIT=y
#BR2_LINUX_KERNEL_CUSTOM_REPO_URL="/Repos/system/linux"
#BR2_LINUX_KERNEL_CUSTOM_REPO_VERSION="heven/timebox"
#BR2_LINUX_KERNEL_DEFCONFIG="timebox_defconfig"


# Rootfs
BR2_TARGET_ROOTFS_CPIO=y
BR2_TARGET_ROOTFS_CPIO_GZIP=y
BR2_TARGET_ROOTFS_EXT2=y
BR2_TARGET_ROOTFS_EXT2_4=y
#BR2_TARGET_ROOTFS_INITRAMFS=y
BR2_TARGET_ROOTFS_TAR_GZIP=y



# Bootloader
BR2_TARGET_UBOOT=y
BR2_TARGET_UBOOT_BOARDNAME="m8_k200_v1"
BR2_TARGET_UBOOT_CUSTOM_GIT=y
#BR2_TARGET_UBOOT_CUSTOM_REPO_URL="https://github.com/linux-knight/uboot.git"
BR2_TARGET_UBOOT_CUSTOM_REPO_URL="/Repos/system/uboot"
BR2_TARGET_UBOOT_CUSTOM_REPO_VERSION="heven/timebox"
BR2_TARGET_UBOOT_FORMAT_CUSTOM=y
BR2_TARGET_UBOOT_FORMAT_CUSTOM_NAME="u-boot-with-spl.bin"



#BR2_ENABLE_DEBUG=y
#BR2_PACKAGE_HOST_GDB=y
BR2_PACKAGE_BUSYBOX_SHOW_OTHERS=y

#BR2_ROOTFS_OVERLAY="board/amlogic/meson8_k200/rootfs/"
BR2_PACKAGE_ALSA_UTILS=y
BR2_PACKAGE_ALSA_UTILS_ALSACONF=y
BR2_PACKAGE_ALSA_UTILS_AMIXER=y
BR2_PACKAGE_ALSA_UTILS_APLAY=y
BR2_PACKAGE_GSTREAMER=y
BR2_PACKAGE_GST_PLUGINS_BASE_PLUGIN_ALSA=y
BR2_PACKAGE_GST_PLUGINS_GOOD=y
BR2_PACKAGE_GST_PLUGINS_GOOD_PLUGIN_APETAG=y
BR2_PACKAGE_GST_PLUGINS_GOOD_PLUGIN_AUDIOPARSERS=y
BR2_PACKAGE_GST_PLUGINS_GOOD_PLUGIN_AUTODETECT=y
BR2_PACKAGE_GST_PLUGINS_GOOD_PLUGIN_ID3DEMUX=y
BR2_PACKAGE_GST_PLUGINS_GOOD_PLUGIN_ISOMP4=y
BR2_PACKAGE_GST_PLUGINS_GOOD_PLUGIN_MATROSKA=y
BR2_PACKAGE_GST_PLUGINS_GOOD_PLUGIN_SOUPHTTPSRC=y
BR2_PACKAGE_GST_PLUGINS_GOOD_PLUGIN_WAVPACK=y
BR2_PACKAGE_GST_PLUGINS_BAD=y
BR2_PACKAGE_GST_PLUGINS_BAD_PLUGIN_H264PARSE=y
BR2_PACKAGE_GST_PLUGINS_BAD_PLUGIN_ID3TAG=y
BR2_PACKAGE_GST_PLUGINS_BAD_PLUGIN_MPEGDEMUX=y
BR2_PACKAGE_GST_PLUGINS_BAD_PLUGIN_MPEGTSDEMUX=y
BR2_PACKAGE_GST_PLUGINS_BAD_PLUGIN_DIRECTFB=y
BR2_PACKAGE_GST_PLUGINS_UGLY=y
BR2_PACKAGE_GST_PLUGINS_UGLY_PLUGIN_ASFDEMUX=y
BR2_PACKAGE_GST_PLUGINS_UGLY_PLUGIN_MPEGAUDIOPARSE=y
BR2_PACKAGE_GST_PLUGINS_UGLY_PLUGIN_MAD=y
BR2_PACKAGE_GDB=y
BR2_PACKAGE_GDB_SERVER=y
BR2_PACKAGE_GDB_DEBUGGER=y
BR2_PACKAGE_E2FSPROGS=y
BR2_PACKAGE_FBDUMP=y
BR2_PACKAGE_FBGRAB=y
BR2_PACKAGE_FBSET=y
BR2_PACKAGE_FB_TEST_APP=y
BR2_PACKAGE_FBTERM=y
BR2_PACKAGE_QT5=y
BR2_PACKAGE_QT5BASE_LICENSE_APPROVED=y
BR2_PACKAGE_QT5BASE_EXAMPLES=y
BR2_PACKAGE_QT5BASE_CONCURRENT=y
BR2_PACKAGE_QT5BASE_SQL=y
BR2_PACKAGE_QT5BASE_SQLITE_SYSTEM=y
BR2_PACKAGE_QT5BASE_TEST=y
BR2_PACKAGE_QT5BASE_LINUXFB=y
BR2_PACKAGE_QT5BASE_DIRECTFB=y
BR2_PACKAGE_QT5BASE_PRINTSUPPORT=y
BR2_PACKAGE_QT5BASE_FONTCONFIG=y
BR2_PACKAGE_QT5BASE_GIF=y
BR2_PACKAGE_QT5BASE_JPEG=y
BR2_PACKAGE_QT5BASE_PNG=y
BR2_PACKAGE_QT5BASE_DBUS=y
BR2_PACKAGE_QT5BASE_TSLIB=y
BR2_PACKAGE_QT5IMAGEFORMATS=y
BR2_PACKAGE_QT5QUICK1=y
BR2_PACKAGE_QT5SENSORS=y
BR2_PACKAGE_QT5SERIALPORT=y
BR2_PACKAGE_QT5SVG=y
BR2_PACKAGE_QT5WEBKIT=y
BR2_PACKAGE_OPENSSL=y
BR2_PACKAGE_CAIRO_SCRIPT=y
BR2_PACKAGE_LIBJPEG=y
BR2_PACKAGE_PANGO=y
BR2_PACKAGE_CJSON=y
BR2_PACKAGE_LIBXSLT=y
BR2_PACKAGE_LIBPLAYER=y
BR2_PACKAGE_LIBCURL=y
BR2_PACKAGE_BOOST=y
BR2_PACKAGE_LIBEVENT=y
BR2_PACKAGE_DHCPCD=y
BR2_PACKAGE_DNSMASQ=y
# BR2_PACKAGE_DNSMASQ_TFTP is not set
# BR2_PACKAGE_DNSMASQ_DHCP is not set
BR2_PACKAGE_IW=y
BR2_PACKAGE_WPA_SUPPLICANT=y
BR2_PACKAGE_WPA_SUPPLICANT_CLI=y
BR2_PACKAGE_KMOD=y
#BR2_PACKAGE_GPU=y
#BR2_PACKAGE_GPU_VERSION="r4p0-01"
#BR2_PACKAGE_GPU_CUSTOM_TARBALL_LOCATION="http://openlinux.amlogic.com:8000/download/ARM/gpu/gpu-2014-06-18-14752c29f0.tar.gz"
#BR2_PACKAGE_OPENGL_MALI_VERSION="MALI450"
#BR2_PACKAGE_WIFI_FW=y
#BR2_PACKAGE_WIFI_CUSTOM_GIT_VERSION="2014-06-18-bab235a9c5"
#BR2_PACKAGE_WIFI_FW_CUSTOM_GIT_REPO_URL="http://openlinux.amlogic.com:8000/download/ARM/wifi"
#BR2_PACKAGE_WIFI_FW_WIFI_MODULE="bcm40183"
#BR2_PACKAGE_RTK8188EU=y
#BR2_PACKAGE_RTK8188EU_GIT_VERSION="2014-06-18-b6d4d1bbfc"
#BR2_PACKAGE_RTK8188EU_GIT_REPO_URL="http://openlinux.amlogic.com:8000/download/ARM/wifi"
#BR2_PACKAGE_RTK8192CU=y
#BR2_PACKAGE_RTK8192CU_GIT_VERSION="2014-06-18-54bde7d73d"
#BR2_PACKAGE_RTK8192CU_GIT_REPO_URL="http://openlinux.amlogic.com:8000/download/ARM/wifi"
#BR2_PACKAGE_RTK8192DU=y
#BR2_PACKAGE_RTK8192DU_GIT_VERSION="2014-06-18-7f70d95d29"
#BR2_PACKAGE_RTK8192DU_GIT_REPO_URL="http://openlinux.amlogic.com:8000/download/ARM/wifi"
#BR2_PACKAGE_RTK8192EU=y
#BR2_PACKAGE_RTK8192EU_GIT_VERSION="2014-06-18-6c43487b83"
#BR2_PACKAGE_RTK8192EU_GIT_REPO_URL="http://openlinux.amlogic.com:8000/download/ARM/wifi"
#BR2_PACKAGE_BRCMAP6XXX=y
#BR2_PACKAGE_BRCMAP6XXX_GIT_VERSION="2014-06-18-ba8b8e7a23"
#BR2_PACKAGE_BRCMAP6XXX_GIT_REPO_URL="http://openlinux.amlogic.com:8000/download/ARM/wifi"
#BR2_PACKAGE_AML_TVIN=y
#BR2_PACKAGE_AML_TVIN_GIT_VERSION="2014-06-18-4ce82b808e"
#BR2_PACKAGE_AML_TVIN_GIT_REPO_URL="http://openlinux.amlogic.com:8000/download/ARM/modules"
#BR2_PACKAGE_AML_PMU=y
#BR2_PACKAGE_AML_PMU_GIT_VERSION="2014-06-18-07d7a1b589"
#BR2_PACKAGE_AML_PMU_GIT_REPO_URL="http://openlinux.amlogic.com:8000/download/ARM/modules"
#BR2_PACKAGE_MALI_EXAMPLES=y
#BR2_PACKAGE_AML_NAND=y
#BR2_PACKAGE_AML_NAND_VERSION="2014-06-18-f60aa09b10"
#BR2_PACKAGE_AML_NAND_GIT_URL="http://openlinux.amlogic.com:8000/download/ARM/modules"
#BR2_PACKAGE_AML_UTIL=y


#BR2_LINUX_KERNEL=y
#BR2_LINUX_KERNEL_CUSTOM_TARBALL=y
#BR2_LINUX_KERNEL_CUSTOM_TARBALL_LOCATION="http://openlinux.amlogic.com:8000/download/ARM/kernel/arm-src-kernel-2014-06-18-155d61a24e.tar.gz"
#BR2_LINUX_KERNEL_PATCH="linux/amlogic-3.10"
#BR2_LINUX_KERNEL_DEFCONFIG="meson8"
#BR2_LINUX_KERNEL_DTS_SUPPORT=y
#BR2_LINUX_KERNEL_INTREE_DTS_NAME="meson8_k200a_1G"
#BR2_ROOTFS_OVERLAY="board/amlogic/meson8_k200/rootfs/"
#BR2_LINUX_KERNEL=y
#BR2_LINUX_KERNEL_CUSTOM_TARBALL=y
#BR2_LINUX_KERNEL_CUSTOM_TARBALL_LOCATION="http://openlinux.amlogic.com:8000/download/ARM/kernel/arm-src-kernel-2014-06-18-155d61a24e.tar.gz"
#BR2_LINUX_KERNEL_DEFCONFIG="meson8"
#BR2_TARGET_BOARD_PLATFORM="meson8"
#BR2_LINUX_KERNEL_PATCH="linux/amlogic-3.10"
#BR2_LINUX_KERNEL_DTS_SUPPORT=y
#BR2_LINUX_KERNEL_USE_INTREE_DTS=y
#BR2_LINUX_KERNEL_INTREE_DTS_NAME="meson8_k200a_1G"
#BR2_LINUX_KERNEL_AMLOGIC_DTD=y
```

## external/package/toybox/Config.in
```kconfig
config BR2_PACKAGE_TOYBOX
	bool "Toybox"
	depends on BR2_LARGEFILE && BR2_USE_WCHAR
	help
	  Toybox combines common Linux command line utilities together into
	  a single executable that's simple, small, fast, and reasonably
	  standards compliant.

	  It was started by an ex-maintainer of BusyBox, and uses the same
	  "multicall binary configured at build time via menuconfig" approach,
	  but is a fresh implementation that uses no busybox code.

	  Toybox is licensed under a "zero clause" BSD variant which grants
	  the same blanket permissions but removes the requirement to copy
	  specific license text into derivative works, essentially placing
	  its code into the public domain.

config BR2_PACKAGE_TOYBOX_CONFIG
	string "Toybox configuration file:"
	default "package/toybox/toybox.config"
	depends on BR2_PACKAGE_TOYBOX
	help
	  Specify an alternative config file location enabling a different
	  set of commands in toybox. The default file equals "make defconfig".
```
